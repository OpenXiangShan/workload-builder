## br2-external/configs/boom_defconfig
```kconfig
# BOOM RV64GC, 2 GiB, single hart. Bootlin rv64gc toolchain.
BR2_riscv=y
BR2_RISCV_ISA_RVC=y
BR2_TOOLCHAIN_EXTERNAL=y
BR2_TARGET_GENERIC_HOSTNAME="boom"
BR2_TARGET_GENERIC_ISSUE="BOOM FPGA Test Image"
BR2_TARGET_GENERIC_ROOT_PASSWD="xiangshan"
BR2_LINUX_KERNEL=y
BR2_LINUX_KERNEL_USE_CUSTOM_CONFIG=y
BR2_LINUX_KERNEL_CUSTOM_CONFIG_FILE="${BR2_EXTERNAL}/board/openxiangshan/nemu/linux.config"
BR2_LINUX_KERNEL_CONFIG_FRAGMENT_FILES="${BR2_EXTERNAL}/board/openxiangshan/nemu/linux-boom.fragment"
BR2_TARGET_ROOTFS_INITRAMFS=y
BR2_PACKAGE_BUSYBOX_CONFIG_FRAGMENT_FILES="${BR2_EXTERNAL}/board/openxiangshan/nemu/busybox-taskset.fragment"
BR2_PACKAGE_NEMU_TRAP=y
BR2_PACKAGE_NEMU_EXEC=y
# BR2_PACKAGE_NEMU_EXEC_PROFILE is not set
```

## br2-external/configs/nemu_virt_host_defconfig
```kconfig
BR2_riscv=y
BR2_RISCV_ISA_RVC=y
BR2_TOOLCHAIN_EXTERNAL=y
BR2_TARGET_GENERIC_HOSTNAME="xiangshan-virt-host"
BR2_TARGET_GENERIC_ISSUE="Xiangshan NEMU virtualization host"
BR2_LINUX_KERNEL=y
BR2_LINUX_KERNEL_USE_CUSTOM_CONFIG=y
BR2_LINUX_KERNEL_CUSTOM_CONFIG_FILE="${BR2_EXTERNAL}/board/openxiangshan/nemu/linux-virt-host.config"
BR2_TARGET_ROOTFS_CPIO=y
BR2_TARGET_ROOTFS_CPIO_FULL=y
BR2_TARGET_ROOTFS_CPIO_NONE=y
BR2_PACKAGE_BUSYBOX_CONFIG_FRAGMENT_FILES="${BR2_EXTERNAL}/board/openxiangshan/nemu/busybox-taskset.fragment"
BR2_PACKAGE_NEMU_TRAP=y
BR2_PACKAGE_QEMU=y
BR2_PACKAGE_QEMU_SYSTEM=y
BR2_PACKAGE_QEMU_CHOOSE_TARGETS=y
BR2_PACKAGE_QEMU_TARGET_RISCV64=y
```

## br2-external/configs/nutshell_defconfig
```kconfig
# NutShell RV64IMAC/LP64. Bootlin only ships lp64d, so Buildroot builds gcc.
# Keep nemu_defconfig for XiangShan/NEMU (Bootlin rv64gc).
BR2_riscv=y
BR2_riscv_custom=y
BR2_RISCV_ISA_RVM=y
BR2_RISCV_ISA_RVA=y
BR2_RISCV_ISA_RVC=y
BR2_RISCV_64=y
BR2_RISCV_ABI_LP64=y
BR2_TOOLCHAIN_BUILDROOT=y
BR2_TOOLCHAIN_BUILDROOT_GLIBC=y
BR2_TARGET_GENERIC_HOSTNAME="nutshell"
BR2_TARGET_GENERIC_ISSUE="NutShell rv64imac/lp64"
BR2_TARGET_GENERIC_ROOT_PASSWD="xiangshan"
BR2_LINUX_KERNEL=y
BR2_LINUX_KERNEL_USE_CUSTOM_CONFIG=y
BR2_LINUX_KERNEL_CUSTOM_CONFIG_FILE="${BR2_EXTERNAL}/board/openxiangshan/nemu/linux.config"
BR2_LINUX_KERNEL_CONFIG_FRAGMENT_FILES="${BR2_EXTERNAL}/board/openxiangshan/nemu/linux-nutshell.fragment"
BR2_TARGET_ROOTFS_INITRAMFS=y
BR2_PACKAGE_BUSYBOX_CONFIG_FRAGMENT_FILES="${BR2_EXTERNAL}/board/openxiangshan/nemu/busybox-taskset.fragment"
BR2_PACKAGE_NEMU_TRAP=y
BR2_PACKAGE_NEMU_EXEC=y
```

## br2-external/package/nemu-exec/Config.in
```kconfig
config BR2_PACKAGE_NEMU_EXEC
	bool "nemu-trap"
	depends on BR2_RISCV_ISA_RVI
	help
	  NEMU workload shim.

	  https://github.com/scratch-er/nemu-workloads

config BR2_PACKAGE_NEMU_EXEC_PROFILE
	bool "emit startup profiling markers"
	depends on BR2_PACKAGE_NEMU_EXEC
	default y
	help
	  Emit trap codes 0x100 and 0x101 before starting the workload.
	  Disable on BOOM, where every trap terminates the simulation.
	  The final waitpid status is always reported, including 0x100.
```
